## app/boards/ellie/yureader/board.yml
```yaml
board:
  name: yureader
  full_name: YuReader
  vendor: ellie
  socs:
    - name: nrf54l15
```

## app/drivers/charger/Kconfig.bq25628e
```kconfig
config CHARGER_BQ25628E
    bool "BQ25628E Battery Charger"
    default y
    depends on DT_HAS_TI_BQ25628E_ENABLED
    depends on I2C
    help
      Enable BQ25628E battery charger driver.
```
